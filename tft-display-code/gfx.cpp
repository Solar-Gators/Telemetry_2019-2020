//File Name: gfx.cpp
//Description: This defines the implementation for the graphics fx library

//Include Files
#include "gfx.h"
#include "hspi.h"

//Defines
#ifndef _swap_int16_t
#define _swap_int16_t(a, b) { int16_t t = a; a = b; b = t; }
#endif

#ifndef abs
#define abs(x) (x < 0 ? (x * -1) : x)
#endif

#ifndef pgm_read_byte
 #define pgm_read_byte(addr) (*(const unsigned char *)(addr))
#endif
//Private Constants

//Private Variables
namespace{
    extern const unsigned char font[];
}
//Public Constants

//Public Variables

//Private Function Prototypes

//Public Function Prototypes

//Private Function Definitions
uint8_t TFT_GFX::getWordSize(const char* string)
{
	uint8_t counter = 0;
	while(*string != ' ' && *string != '\0')
	{
		counter++;
		string++;
	}
	return counter;
}

uint8_t TFT_GFX::getLineSize(const char* string, uint8_t max_chars_in_line)
{
	uint8_t currCharsInLine = 0;
	bool overFlowed = false;
	while(*string && !overFlowed)
	{
		uint8_t nextWordSize = this->getWordSize(string);
		//This is to account for spaces
		if(nextWordSize == 0)
		{
			nextWordSize = 1;
		}
		//Check if we overflow
		if(currCharsInLine + nextWordSize > max_chars_in_line)
		{
			if(currCharsInLine == 0)
			{
				currCharsInLine = max_chars_in_line;
			}
			overFlowed = true;
		}else{
			currCharsInLine += nextWordSize;
			string += nextWordSize;
		}
	}
	return currCharsInLine;
}

uint8_t TFT_GFX::getStringSize(const char* string)
{
	uint8_t counter = 0;
	while(*(string++))
	{
		counter++;
	}
	return counter;
}
//Public Function Definitions
TFT_GFX::TFT_GFX(SPI_TypeDef *SPIx):
spiInstance{SPIx}, _width{ILI9341_TFTWIDTH}, _height{ILI9341_TFTHEIGHT}
{}

void TFT_GFX::setAddrWindow(uint16_t x1, uint16_t y1, uint16_t w, uint16_t h)
{
    uint16_t x2 = (x1 + w - 1);
    uint16_t y2 = (y1 + h - 1);
	// Set column range.
	hspi_cmd(this->spiInstance, 0x2A);
	hspi_w16(this->spiInstance, x1);
	hspi_w16(this->spiInstance, x2);
	
	// Set row range.
	hspi_cmd(this->spiInstance, 0x2B);
	hspi_w16(this->spiInstance, y1);
	hspi_w16(this->spiInstance, y2);
	
	// Set 'write to RAM'
	hspi_cmd(this->spiInstance, 0x2C);
}

void TFT_GFX::writePixel(int16_t x, int16_t y, uint16_t color) 
{
    if((x >= 0) && (x < this->_width) && (y >= 0) && (y < this->_height)) 
    {
        setAddrWindow(x, y, 1, 1);
        hspi_w16(this->spiInstance, color);
    }
}

void TFT_GFX::writeFillRect(int16_t x, int16_t y,
  int16_t w, int16_t h, uint16_t color) {
    if(w && h) {                            // Nonzero width and height?
        if(w < 0) {                         // If negative width...
            x +=  w + 1;                    //   Move X to left edge
            w  = -w;                        //   Use positive width
        }
        if(x < this->_width) {                    // Not off right
            if(h < 0) {                     // If negative height...
                y +=  h + 1;                //   Move Y to top edge
                h  = -h;                    //   Use positive height
            }
            if(y < this->_height) {               // Not off bottom
                int16_t x2 = x + w - 1;
                if(x2 >= 0) {               // Not off left
                    int16_t y2 = y + h - 1;
                    if(y2 >= 0) {           // Not off top
                        // Rectangle partly or fully overlaps screen
                        if(x  <  0)       { x = 0; w = x2 + 1; } // Clip left
                        if(y  <  0)       { y = 0; h = y2 + 1; } // Clip top
                        if(x2 >= this->_width)  { w = this->_width  - x;   } // Clip right
                        if(y2 >= this->_height) { h = this->_height - y;   } // Clip bottom
                        writeFillRectPreclipped(x, y, w, h, color);
                    }
                }
            }
        }
    }
}

inline void TFT_GFX::writeFillRectPreclipped(int16_t x, int16_t y,
  int16_t w, int16_t h, uint16_t color) {
    setAddrWindow(x, y, w, h);
    writeColor(color, (uint32_t)w * h);
}

void TFT_GFX::writeColor(uint16_t color, uint32_t len){
	for(uint32_t i = 0; i < len; i++){
		hspi_w16(this->spiInstance, color);
	}
}

void inline TFT_GFX::writeFastVLine(int16_t x, int16_t y, int16_t h, uint16_t color) {
    if((x >= 0) && (x < this->_width) && h) { // X on screen, nonzero height
        if(h < 0) {                     // If negative height...
            y +=  h + 1;                //   Move Y to top edge
            h  = -h;                    //   Use positive height
        }
        if(y < this->_height) {               // Not off bottom
            int16_t y2 = y + h - 1;
            if(y2 >= 0) {               // Not off top
                // Line partly or fully overlaps screen
                if(y  <  0)       { y = 0; h = y2 + 1; } // Clip top
                if(y2 >= this->_height) { h = this->_height - y;   } // Clip bottom
                writeFillRectPreclipped(x, y, 1, h, color);
            }
        }
    }
}

void inline TFT_GFX::writeFastHLine(int16_t x, int16_t y, int16_t w,
  uint16_t color) {
    if((y >= 0) && (y < this->_height) && w) { // Y on screen, nonzero width
        if(w < 0) {                      // If negative width...
            x +=  w + 1;                 //   Move X to left edge
            w  = -w;                     //   Use positive width
        }
        if(x < this->_width) {                 // Not off right
            int16_t x2 = x + w - 1;
            if(x2 >= 0) {                // Not off left
                // Line partly or fully overlaps screen
                if(x  <  0)       { x = 0; w = x2 + 1; } // Clip left
                if(x2 >= this->_width)  { w = this->_width  - x;   } // Clip right
                writeFillRectPreclipped(x, y, w, 1, color);
            }
        }
    }
}

void TFT_GFX::drawChar(int16_t x, int16_t y, unsigned char c, uint16_t color, uint16_t bg, uint8_t size_x, uint8_t size_y) 
{
    if((x >= this->_width)            || // Clip right
        (y >= this->_height)           || // Clip bottom
        ((x + 6 * size_x - 1) < 0) || // Clip left
        ((y + 8 * size_y - 1) < 0))   // Clip top
        return;

    if(c >= 176) c++; // Handle 'classic' charset behavior

    //startWrite();
    for(int8_t i=0; i<5; i++ ) { // Char bitmap = 5 columns
        uint8_t line = pgm_read_byte(&font[c * 5 + i]);
        for(int8_t j=0; j<8; j++, line >>= 1) {
            if(line & 1) {
                if(size_x == 1 && size_y == 1)
                    writePixel(x+i, y+j, color);
                else
                    writeFillRect(x+i*size_x, y+j*size_y, size_x, size_y, color);
            } else if(bg != color) {
                if(size_x == 1 && size_y == 1)
                    writePixel(x+i, y+j, bg);
                else
                    writeFillRect(x+i*size_x, y+j*size_y, size_x, size_y, bg);
            }
        }
    }
    if(bg != color) { // If opaque, draw vertical line for last column
        if(size_x == 1 && size_y == 1) writeFastVLine(x+5, y, 8, bg);
        else          writeFillRect(x+5*size_x, y, size_x, 8*size_y, bg);
    }
    //endWrite();
}

std::pair<uint16_t, uint16_t> TFT_GFX::drawString(int16_t init_x, int16_t init_y, const char* s, uint16_t color, uint16_t bg, uint8_t size_x, uint8_t size_y, uint16_t x_edge, bool do_center)
{
	uint8_t totalChars = this->getStringSize(s);
	totalChars = (totalChars > TFT_GFX::MAX_STRING_LENGTH ? TFT_GFX::MAX_STRING_LENGTH : totalChars);

	uint16_t currX = init_x;
	uint16_t currY = init_y;

	uint16_t maxX = init_x;
	uint16_t maxY = init_y + (size_y * 8);

	const uint8_t maxCharsInLine = (x_edge - init_x)/(size_x * 6);
	while(*s)
	{
		uint8_t currLineSize = this->getLineSize(s, maxCharsInLine);
		uint8_t functionalLineSize;
		if(s[currLineSize - 1] == ' ')
		{
			functionalLineSize = currLineSize - 1;
		}else{
			functionalLineSize = currLineSize;
		}

		if(do_center)
		{
			currX = ((x_edge - init_x) - (functionalLineSize * size_x * 6))/2 + init_x;
		}else{
			currX = init_x;
		}

		for(uint8_t i = 0; i < functionalLineSize; i++)
		{
			drawChar(currX,currY,*(s++),color,bg,size_x,size_y);
			currX += size_x * 6;
			if(currX > maxX)
			{
				maxX = currX;
			}
		}
		//Skip the space
		s += (functionalLineSize == currLineSize ? 0 : 1);
		//Go to next row
		currY += size_y * 8;
		//If the next line starts with a space lets just skip it
		if(*s == ' ')
		{
			s++;
		}
	}
	maxY = currY;
	if(maxX > this->_width)
	{
		maxX = this->_width;
	}
	if(maxY > this->_height)
	{
		maxY = this->_height;
	}
	return std::make_pair(maxX, maxY);
}

void TFT_GFX::setRotation(uint8_t m)
{
	uint8_t rotation = m % 4; // can't be higher than 3
	    switch (rotation) {
	        case 0:
	            m = (MADCTL_MX | MADCTL_BGR);
	            _width  = ILI9341_TFTWIDTH;
	            _height = ILI9341_TFTHEIGHT;
	            break;
	        case 1:
	            m = (MADCTL_MV | MADCTL_BGR);
	            _width  = ILI9341_TFTHEIGHT;
	            _height = ILI9341_TFTWIDTH;
	            break;
	        case 2:
	            m = (MADCTL_MY | MADCTL_BGR);
	            _width  = ILI9341_TFTWIDTH;
	            _height = ILI9341_TFTHEIGHT;
	            break;
	        case 3:
	            m = (MADCTL_MX | MADCTL_MY | MADCTL_MV | MADCTL_BGR);
	            _width  = ILI9341_TFTHEIGHT;
	            _height = ILI9341_TFTWIDTH;
	            break;
	    }
	    sendCommand(this->spiInstance, ILI9341_MADCTL, &m, 1);
}

uint16_t TFT_GFX::width(void)
{
	return this->_width;
}

uint16_t TFT_GFX::height(void)
{
	return this->_height;
}
// Standard ASCII 5x7 font
namespace {
const unsigned char font[] = {
	0x00, 0x00, 0x00, 0x00, 0x00,
	0x3E, 0x5B, 0x4F, 0x5B, 0x3E,
	0x3E, 0x6B, 0x4F, 0x6B, 0x3E,
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	0x00, 0x00, 0x00, 0x00, 0x00  // #255 NBSP
};

}
